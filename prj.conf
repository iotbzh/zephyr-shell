## prj.conf
```kconfig
CONFIG_SERIAL=y
CONFIG_CONSOLE=y
CONFIG_UART_CONSOLE=y
CONFIG_LOG=y
CONFIG_SHELL=y
CONFIG_GPIO=y
CONFIG_GPIO_SHELL=y
CONFIG_CAN=y
CONFIG_CAN_SHELL=y
CONFIG_I2C=y
CONFIG_I2C_SHELL=y
CONFIG_PWM=y
CONFIG_PWM_SHELL=y
CONFIG_LOG_CMDS=y
```

## src/main.c
```c
#include <zephyr/kernel.h>

void main()
{
    printk("Starting Zephyr shell. (%s)\n", CONFIG_BOARD);
}
```
